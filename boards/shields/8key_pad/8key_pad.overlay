/ {
    chosen {
        zmk,kscan = &kscan0;
    };

    kscan0: kscan {
        compatible = "zmk,kscan-gpio-direct";
        label = "KSCAN";

        input-gpios = <
            &gpio0 11 (GPIO_PULL_UP | GPIO_ACTIVE_LOW)
            &gpio0 12 (GPIO_PULL_UP | GPIO_ACTIVE_LOW)
            &gpio0 24 (GPIO_PULL_UP | GPIO_ACTIVE_LOW)
            &gpio1  0 (GPIO_PULL_UP | GPIO_ACTIVE_LOW)
            &gpio0 30 (GPIO_PULL_UP | GPIO_ACTIVE_LOW)
            &gpio0 31 (GPIO_PULL_UP | GPIO_ACTIVE_LOW)
            &gpio0 29 (GPIO_PULL_UP | GPIO_ACTIVE_LOW)
            &gpio0  2 (GPIO_PULL_UP | GPIO_ACTIVE_LOW)
        >;
    };
};
